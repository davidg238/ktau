## CMakeLists.txt
```
cmake_minimum_required(VERSION 3.20.0)
find_package(Zephyr REQUIRED HINTS $ENV{ZEPHYR_BASE})
project(pcmplay)
target_sources(app PRIVATE src/main.c)
# Plays every clips/*.pcm (raw 16 kHz s16le mono) in name order. clips/ is git-ignored (audio derived from TTS
# voices); tools/relp_reference.py "<text>" c/pcmplay/clips makes one set.
set(gen ${ZEPHYR_BINARY_DIR}/include/generated)
file(GLOB clips CONFIGURE_DEPENDS ${CMAKE_CURRENT_SOURCE_DIR}/clips/*.pcm)
list(SORT clips)
set(decls "")
set(table "")
set(i 0)
foreach(clip ${clips})
  get_filename_component(name ${clip} NAME_WLE)
  generate_inc_file_for_target(app ${clip} ${gen}/clip${i}.inc)
  string(APPEND decls "static const uint8_t clip${i}[] __aligned(2) = {\n#include <clip${i}.inc>\n};\n")
  string(APPEND table "  {\"${name}\", clip${i}, sizeof clip${i}},\n")
  math(EXPR i "${i} + 1")
endforeach()
file(WRITE ${gen}/clips.h "${decls}static const struct clip clips[] = {\n${table}};\n")
```

## prj.conf
```kconfig
# ktau #6: host-made clips (16 kHz s16le mono) from flash through the MAX98357A, to judge a codec idea by ear on
# the real speaker before any of it is written for the board.
CONFIG_I2S=y
CONFIG_MAIN_STACK_SIZE=2048
CONFIG_LOG=y
CONFIG_LOG_MODE_IMMEDIATE=y
CONFIG_I2S_LOG_LEVEL_INF=y
```

## src/main.c
```c
/* ktau #6: play host-made clips from flash through I2S20 and the MAX98357A, once per boot, a second apart.
 * The clips are raw 16 kHz 16-bit mono (tools/relp_reference.py writes them); nothing is decoded here, so what
 * is heard is the host experiment on the real speaker. */
#include <string.h>
#include <zephyr/drivers/i2s.h>
#include <zephyr/kernel.h>

#define RATE 16000
#define BLOCK_FRAMES (RATE / 50) /* 20 ms */
#define BLOCK_BYTES (BLOCK_FRAMES * 2 * sizeof(int16_t))
#define N_BLOCKS 6
#define QUIETER 3 /* right shift, as c/phrasecheck */

K_MEM_SLAB_DEFINE_STATIC(tx_slab, BLOCK_BYTES, N_BLOCKS, 4);

struct clip {
  const char *name;
  const uint8_t *pcm;
  size_t len;
};
#include <clips.h> /* generated from clips/ by CMakeLists.txt */

static void play(const struct device *i2s, const char *name, const int16_t *pcm, size_t samples) {
  int blocks = 0, err = 0;
  size_t at = 0;
  for (;;) {
    void *mem;
    if (k_mem_slab_alloc(&tx_slab, &mem, K_MSEC(1000))) {
      printk("pcmplay: %s: no free block after %d\n", name, blocks);
      break;
    }
    int16_t *s = mem;
    size_t n = MIN(BLOCK_FRAMES, samples - at);
    for (size_t i = 0; i < BLOCK_FRAMES; i++) s[2 * i] = s[2 * i + 1] = i < n ? pcm[at + i] >> QUIETER : 0;
    at += n;
    if (i2s_write(i2s, mem, BLOCK_BYTES)) {
      k_mem_slab_free(&tx_slab, mem);
      printk("pcmplay: %s: write failed after %d\n", name, blocks);
      break;
    }
    if (n == 0) break; /* that was one block of silence after the clip */
    if (++blocks == 2) {
      err = i2s_trigger(i2s, I2S_DIR_TX, I2S_TRIGGER_START);
      if (err) break;
    }
  }
  int drain = i2s_trigger(i2s, I2S_DIR_TX, I2S_TRIGGER_DRAIN);
  k_msleep(1000); /* the queue drains, then a pause before the next clip */
  printk("pcmplay: %s: %u ms, %d blocks, err %d, drain %d\n", name, (unsigned)(samples * 1000 / RATE), blocks, err,
         drain);
}

int main(void) {
  const struct device *i2s = DEVICE_DT_GET(DT_NODELABEL(i2s20));
  if (!device_is_ready(i2s)) {
    printk("pcmplay: i2s20 not ready\n");
    return 0;
  }
  struct i2s_config cfg = {
      .word_size = 16,
      .channels = 2,
      .format = I2S_FMT_DATA_FORMAT_I2S,
      .options = I2S_OPT_BIT_CLK_CONTROLLER | I2S_OPT_FRAME_CLK_CONTROLLER,
      .frame_clk_freq = RATE,
      .mem_slab = &tx_slab,
      .block_size = BLOCK_BYTES,
      .timeout = 1000,
  };
  int err = i2s_configure(i2s, I2S_DIR_TX, &cfg);
  printk("pcmplay: configure %d\n", err);
  if (err) return 0;
  for (size_t i = 0; i < ARRAY_SIZE(clips); i++) {
    play(i2s, clips[i].name, (const int16_t *)clips[i].pcm, clips[i].len / 2);
  }
  printk("pcmplay: done\n");
  return 0;
}
```
